## CMakeLists.txt
```
cmake_minimum_required(VERSION 3.20.0)

# [수정] Zephyr 패키지 로드 전에 QEMU 벡터 하드웨어 플래그를 주입합니다!
list(APPEND QEMU_EXTRA_FLAGS "-cpu" "rv32,v=true,vlen=128,vext_spec=v1.0")
#list(APPEND QEMU_EXTRA_FLAGS "-cpu" "rv64,v=true,vlen=128,vext_spec=v1.0")

find_package(Zephyr REQUIRED HINTS $ENV{ZEPHYR_BASE})
project(vmath_zephyr)

# 기존 소스코드 경로를 변수로 지정
set(HAL_DIR ${CMAKE_CURRENT_SOURCE_DIR}/../hal)
set(LIB_DIR ${CMAKE_CURRENT_SOURCE_DIR}/../lib)   # <--- [추가] lib 폴더 경로

set(ZEPHYR_APP_DIR ${CMAKE_CURRENT_SOURCE_DIR}/app)
set(ZEPHYR_SRC_DIR ${CMAKE_CURRENT_SOURCE_DIR}/src)

# 헤더 경로 추가
zephyr_include_directories(${HAL_DIR})
zephyr_include_directories(${LIB_DIR})            # <--- [추가] lib 헤더 경로 포함

zephyr_include_directories(${CMAKE_CURRENT_SOURCE_DIR}/lib)

# 소스 코드 컴파일 목록 추가
zephyr_library_sources(
    src/main.c
    lib/vmath_driver.c

    # HAL 계층
    ${HAL_DIR}/riscv32/hal_riscv32_math.S
    ${HAL_DIR}/riscv32/hal_riscv32_array.S
    ${HAL_DIR}/hal_soft_math.c

    # Middleware (lib) 계층 소스 추가 <--- [추가]
    ${LIB_DIR}/nn_layers.c
    ${LIB_DIR}/dsp_fir.c
    ${LIB_DIR}/dsp_iir.c
    ${LIB_DIR}/image_filter.c
    ${LIB_DIR}/dsp_fft.c

    # Application 계층
    ${ZEPHYR_APP_DIR}/test_nn_dense.c
    ${ZEPHYR_APP_DIR}/test_mlp_xor.c
    ${ZEPHYR_APP_DIR}/test_fir.c
    ${ZEPHYR_APP_DIR}/test_iir.c
    ${ZEPHYR_APP_DIR}/test_conv2d.c
)


# Zephyr 앱 타겟에만(PRIVATE) 벡터 컴파일 옵션을 격리해서 적용합니다.
target_compile_options(app PRIVATE -march=rv32gcv -mabi=ilp32d)
```

## prj.conf
```kconfig
# 1. 부동소수점(FPU) 하드웨어 지원 활성화
CONFIG_FPU=y

# 2. C 표준 라이브러리 설정 (Newlib 제거, Picolibc 명시)
CONFIG_PICOLIBC=y

# 3. 콘솔(터미널) 출력 및 Float 출력 지원 (Picolibc 환경에서도 필수)
CONFIG_STDOUT_CONSOLE=y
CONFIG_CBPRINTF_FP_SUPPORT=y

# 4. 메인 스레드 스택 사이즈 확보
CONFIG_MAIN_STACK_SIZE=4096

# 5. RISC-V 벡터 확장(RVV) 활성화
#CONFIG_RISCV_ISA=y

# QEMU 가상 머신 실행 시 사용할 추가 플래그 (벡터 하드웨어 강제 장착)

CONFIG_QEMU_EXTRA_FLAGS="-cpu rv32,v=true,vlen=128,vext_spec=v1.0"
#CONFIG_QEMU_EXTRA_FLAGS="-machine virt -bios none -m 256-cpu max,len=64 -nographic -kernel build/zephyr/zephyr.elf"

# 6. 전원 관리 기능 활성화 (필수는 아니지만, 시스템 안정성 향상에 도움)
#CONFIG_POWEROFF=y
#CONFIG_PM_DEVICE=y
#CONFIG_EVENTS=y
#CONFIG_PM=y
#CONFIG_GPIO=y
#CONFIG_CRC=y
```

## src/main.c
```c
// --- zephyr_app/src/main.c ---
#include "dsp_fft.h"
#include "hal_math.h"
#include "hal_soft_math.h" // C버전 함수가 있는 헤더
#include "image_filter.h"
#include "mnist_data.h" // [추가] 실제 데이터 및 가중치 헤더
#include "nn_layers.h"
#include "vmath_driver.h"
#include <math.h>
#include <stdio.h>
#include <zephyr/kernel.h>

#define MATRIX_SIZE 128 // 256x256 행렬 곱셈 테스트

#ifndef M_PI
#define M_PI (3.14159265358979323846)
#endif

// 기존 애플리케이션 계층 함수들 선언
extern void test_mlp_xor(void);
extern void test_dsp_iir(void);
extern void test_image_conv2d(void);

// ========================================================
// [신규 추가] FFT 파이프라인 버퍼 (BSS 영역)
// ========================================================
#define N_FFT 64
static dsp_complex_f32_t fft_data[N_FFT];
static dsp_complex_f32_t twiddles[N_FFT / 2];

// ========================================================
// TinyML 파이프라인 버퍼 (BSS 영역 할당 - 스택 오버플로우 방지)
// ========================================================
static float input_image[28 * 28];
static float conv_output[28 * 28];
static float pool_output[14 * 14];
static float dense_output[10];
static float conv_kernel[9];
static float dense_weight[14 * 14 * 10];
static float dense_bias[10];

void run_mnist_cnn_pipeline(void) {
    printf("\n🚀 --- Real TinyML CNN (MNIST Digit '7') Pipeline --- 🚀\n");

    // 1. [핵심 변경] 실제 숫자 '7' 데이터와 학습된 가중치 로드
    for (int i = 0; i < 28 * 28; i++) {
        input_image[i] = mnist_digit_7[i];
    }
    load_trained_weights(conv_kernel, dense_weight, dense_bias);

    // 2. 파이프라인 관통 (Conv -> MaxPool -> Dense -> Softmax)
    printf("[1/4] Running Conv2D (28x28)...\n");
    image_conv2d_f32(conv_output, input_image, 28, 28, conv_kernel, 3);

    printf("[2/4] Running Max Pooling (14x14)...\n");
    nn_maxpool_2d_f32(pool_output, conv_output, 28, 28);

    printf("[3/4] Running Dense Layer (196 -> 10)...\n");
    nn_dense_layer_f32(dense_output, pool_output, dense_weight, dense_bias, 14 * 14, 10);

    printf("[4/4] Running Softmax...\n");
    nn_softmax_f32(dense_output, 10);

    // 3. 결과 판별 및 출력
    printf("\n--- Final Classification Probabilities ---\n");

    int best_digit = 0;
    float best_prob = 0.0f;
    float sum = 0.0f;

    for (int i = 0; i < 10; i++) {
        printf("Digit %d: %6.2f %%\n", i, dense_output[i] * 100.0f);
        sum += dense_output[i];

        // 가장 확률이 높은 숫자(Top-1) 찾기
        if (dense_output[i] > best_prob) {
            best_prob = dense_output[i];
            best_digit = i;
        }
    }

    printf("------------------------------------------\n");
    printf("✅ AI Classification Result: It's a '%d' !!! (%.1f%% confidence)\n", best_digit,
           best_prob * 100.0f);
    printf("✅ Total Probability Sum: %.2f\n", sum);
    printf("------------------------------------------\n");
}

void run_performance_benchmark(void) {
    printf("\n--- RISC-V Hardware Cycle Profiling Started ---\n");
    // VMath 하드웨어 드라이버 초기화 (뮤텍스 준비 등)
    vmath_drv_init();

    // 256x256 테스트 데이터 할당
    static float A[MATRIX_SIZE * MATRIX_SIZE];
    static float B[MATRIX_SIZE * MATRIX_SIZE];
    static double Out_C[MATRIX_SIZE * MATRIX_SIZE];
    static double Out_RVV[MATRIX_SIZE * MATRIX_SIZE];

    // 데이터 초기화 (1.0으로 통일)
    for (int i = 0; i < MATRIX_SIZE * MATRIX_SIZE; i++) {
        A[i] = 1.0f;
        B[i] = 1.0f;
    }

    uint32_t start_cycles, end_cycles;
    uint32_t cycles_c, cycles_rvv;

    // 1. C버전 (시간이 좀 걸릴 수 있습니다)
    start_cycles = k_cycle_get_32();
    hal_matrix_vmul_c_f32(Out_C, A, B, MATRIX_SIZE, MATRIX_SIZE, MATRIX_SIZE);
    end_cycles = k_cycle_get_32();
    cycles_c = end_cycles - start_cycles;
    printf("[Scalar C] Execution Cycles: %u\n", cycles_c);

    // 2. RVV버전
    vmath_drv_lock();
    start_cycles = k_cycle_get_32();
    hal_matrix_vmul_tiled_f32(Out_RVV, A, B, MATRIX_SIZE, MATRIX_SIZE, MATRIX_SIZE, 16);
    end_cycles = k_cycle_get_32();
    vmath_drv_unlock();

    cycles_rvv = end_cycles - start_cycles;
    printf("[RVV 128b] Execution Cycles: %u\n", cycles_rvv);

    double speedup = (double)cycles_c / (double)cycles_rvv;
    printf("\n🚀 Total Speedup: %.2f x Faster!\n", speedup);
    printf("-----------------------------------------------\n");
}

// ========================================================
// [신규 추가] FFT 테스트 함수
// ========================================================
void run_fft_pipeline(void) {
    printf("\n🚀 --- RVV Accelerated FFT (64-Point) Started --- 🚀\n");

    // VMath 드라이버 초기화
    vmath_drv_init();

    // 1. Twiddle Factor (회전 인자) 가속 생성
    vmath_drv_lock();
    // hal_fft_init_twiddles_f32(twiddles, N_FFT);
    dsp_fft_init_twiddles_c(twiddles, N_FFT);
    vmath_drv_unlock();
    // printf("[1/3] Twiddle Factors Generated via RVV.\n");
    printf("[1/3] High-Precision Twiddle Factors Generated via math.h\n");

    // 2. 가상 신호 생성 (4Hz와 10Hz가 섞인 복합 사인파)
    for (int i = 0; i < N_FFT; i++) {
        float t = (float)i / N_FFT;
        fft_data[i].real = cosf(2.0f * M_PI * 4.0f * t) + 0.5f * cosf(2.0f * M_PI * 10.0f * t);
        fft_data[i].imag = 0.0f;
    }
    printf("[2/3] Time Domain Signal Generated (4Hz + 10Hz).\n");

    // 3. 대망의 RVV FFT 수행!
    printf("[3/3] Running Radix-2 FFT via RVV Butterfly Engine...\n");
    vmath_drv_lock();
    dsp_fft_radix2_f32(fft_data, twiddles, N_FFT);
    vmath_drv_unlock();

    // 4. 결과 출력 (크기 계산: sqrt(re^2 + im^2))
    printf("\n--- Frequency Domain (Magnitude) ---\n");
    for (int k = 0; k <= N_FFT / 2; k++) { // 나이퀴스트 주파수(절반)까지만 출력
        float magnitude =
            sqrtf(fft_data[k].real * fft_data[k].real + fft_data[k].imag * fft_data[k].imag);

        // 튀는 피크(Peak) 값만 필터링해서 출력
        if (magnitude > 10.0f) {
            printf("🔥 Frequency Bin [%2d] -> Magnitude: %6.2f\n", k, magnitude);
        }
    }
    printf("--------------------------------------------\n");
}

void test_app(void) {
    // VMath 하드웨어 드라이버 초기화 (뮤텍스 준비 등)
    vmath_drv_init();

    printf("==================================\n");
    printf(" VMath on Zephyr RTOS Booted!\n");
    printf("==================================\n");

    // -------------------------------------------------------------
    // [핵심 해킹 포인트]
    // mstatus 레지스터의 VS(Vector Status, 23~24번 비트)를
    // 01(Initial 상태)로 강제로 덮어써서 벡터 가속기 전원을 켭니다!
    // -------------------------------------------------------------
    // __asm__ volatile("csrs mstatus, %0" ::"r"(1 << 23));

    // Zephyr 커널 부팅 완료 후 진입
    printf("==================================\n");
    printf(" VMath on Zephyr RTOS Booted!\n");
    printf("==================================\n");

    // RTOS 환경 위에서 하드웨어 가속기 테스트 실행
    test_mlp_xor();

    // 약간의 딜레이(Sleep)를 주며 멀티태스킹 흉내내기
    k_msleep(1000);

    test_dsp_iir();
    k_msleep(1000);

    test_image_conv2d();

    printf("\n--- All Tasks Completed Successfully ---\n");
}

int main(void) {
    printf("Starting Zephyr Application...\n");

    // test_app();
    // run_performance_benchmark();
    // run_mnist_cnn_pipeline();
    run_fft_pipeline();

    return 0;
}
```
